/* 
 * Copyright Altera Corporation (C) 2015. All rights reserved. 
 * 
 * This program is free software; you can redistribute it and/or modify 
 * it under the terms and conditions of the GNU General Public License, 
 * version 2, as published by the Free Software Foundation. 
 * 
 * This program is distributed in the hope it will be useful, but WITHOUT 
 * ANY WARRANTY; without even the implied warranty of MERCHANTABILITY or 
 * FITNESS FOR A PARTICULAR PURPOSE.  See the GNU General Public License for 
 * more details. 
 * 
 * You should have received a copy of the GNU General Public License along with 
 * this program.  If not, see <http://www.gnu.org/licenses/>. 
 */ 
 
 /dts-v1/ /plugin/; 
/ { 
 
   fragment@0 { 
      target-path = "/soc/base-fpga-region"; 
 
      #address-cells = <2>; 
      #size-cells = <1>; 
      __overlay__ { 
         #address-cells = <2>; 
         #size-cells = <1>; 
			firmware-name = "ECC163_lib.rbf"; 
		}; 
   }; 
};